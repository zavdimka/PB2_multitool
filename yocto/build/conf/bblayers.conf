## yocto/build/conf/bblayers.conf
```bitbake
POKY_BBLAYERS_CONF_VERSION = "2"

BBPATH = "${TOPDIR}"
BBFILES ?= ""

BBLAYERS ?= " \
  ${TOPDIR}/../sources/poky/meta \
  ${TOPDIR}/../sources/poky/meta-poky \
  ${TOPDIR}/../sources/meta-openembedded/meta-oe \
  ${TOPDIR}/../sources/meta-arm/meta-arm-toolchain \
  ${TOPDIR}/../sources/meta-arm/meta-arm \
  ${TOPDIR}/../sources/meta-ti/meta-ti-bsp \
  ${TOPDIR}/../sources/meta-ti/meta-beagle \
  ${TOPDIR}/../sources/meta-ti/meta-ti-extras \
  ${TOPDIR}/../sources/meta-rust-bin \
  ${TOPDIR}/../sources/meta-slint \
  ${TOPDIR}/../meta-pb2 \
  "
```

## yocto/build/conf/local.conf
```bitbake
MACHINE = "pocketbeagle2"
DISTRO = "pb2-fast"

DL_DIR = "${TOPDIR}/../downloads"
SSTATE_DIR = "${TOPDIR}/../sstate-cache"
BB_NUMBER_THREADS = "12"
PARALLEL_MAKE = "-j 12"

IMAGE_LINK_NAME = "${IMAGE_BASENAME}-${MACHINE}"
INHERIT:remove = "testimage"

PREFERRED_VERSION_slint-cpp = "1.18.1"
PREFERRED_VERSION_slint-cpp-native = "1.18.1"

PACKAGECONFIG:append:pn-slint-cpp = " backend-linuxkms "
PACKAGECONFIG:remove:pn-slint-cpp = " renderer-femtovg interpreter "
EXTRA_OECMAKE:append:pn-slint-cpp = " -DSLINT_FEATURE_BACKEND_LINUXKMS_LIBSEAT=ON -DSLINT_FEATURE_BACKEND_LINUXKMS_LIBINPUT=ON "

# The current meta-slint also supports Arago; this image deliberately uses Poky.
BBMASK += "meta-slint/dynamic-layers/meta-ti/recipes-tisdk/tisdk-uenv/"
```

## yocto/meta-pb2/conf/layer.conf
```bitbake
BBPATH .= ":${LAYERDIR}"

BBFILES += "${LAYERDIR}/recipes-*/*/*.bb \
            ${LAYERDIR}/recipes-*/*/*.bbappend"

BBFILE_COLLECTIONS += "pb2"
BBFILE_PATTERN_pb2 = "^${LAYERDIR}/"
BBFILE_PRIORITY_pb2 = "8"

LAYERDEPENDS_pb2 = "core meta-ti-bsp meta-beagle"
LAYERSERIES_COMPAT_pb2 = "scarthgap"

WKS_FILE_PATH:append = ":${LAYERDIR}/wic"
```
